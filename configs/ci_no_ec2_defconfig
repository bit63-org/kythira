## services/ec2/Kconfig
```kconfig
# Copyright (c) 2026 Clark Rawlins
# SPDX-License-Identifier: Apache-2.0

# The Amazon EC2-compatible compute API (services/ec2/,
# .kiro/specs/ec2-compatible-api/). Sourced from the top-level Kconfig's
# "Service Modules" menu.

config EC2
	bool "Amazon EC2-compatible compute API (antikythera's controller)"
	default n
	depends on OPENSSL
	help
	  Builds the services/ec2/ module: an Amazon EC2-compatible API that
	  the AWS CLI, the AWS SDKs and Terraform's AWS provider can point at
	  to launch, stop, start and terminate instances, create and attach
	  EBS-style volumes, take snapshots and make VPCs and network
	  interfaces. The instances run on antikythera servers: this module
	  is antikythera's controller, sending signed commands and frames to
	  each server's helm over a mutually authenticated link. So far the
	  module holds the pinned botocore model, the generated operation
	  table, the coverage check and the ec2_node placeholder (task 1);
	  the codec, gateway, catalog, fleet layer and workflows follow.
	  OpenSSL is needed for SigV4 and the link's TLS. Off by default like
	  every new module (services/README.md). See
	  .kiro/specs/ec2-compatible-api/.
```

## services/hsm/Kconfig
```kconfig
# Copyright (c) 2026 Clark Rawlins
# SPDX-License-Identifier: Apache-2.0

# The virtual HSM (services/hsm/, .kiro/specs/virtual-hsm/). Sourced from the
# top-level Kconfig's "Service Modules" menu.

config HSM
	bool "Virtual HSM (PKCS#11 software HSM on Raft)"
	default n
	depends on OPENSSL
	help
	  Builds the services/hsm/ module: a software HSM that keeps its
	  keys in Kythira Raft groups, sealed under a master key split with
	  Shamir's scheme, and serves them through PKCS#11
	  (libkythira_pkcs11.so) so that consumers can later move to a
	  hardware HSM by configuration alone. Keys are in host memory while
	  in use; it is not a hardware boundary. So far the module holds the
	  vendored OASIS PKCS#11 v3.0 headers and the hsm_node placeholder
	  (task 1); the key store, unseal and the PKCS#11 library follow.
	  Needs OpenSSL 3 for every mechanism. Off by default like every new
	  module (services/README.md). See .kiro/specs/virtual-hsm/.
```

## services/khold/Kconfig
```kconfig
# Copyright (c) 2026 Clark Rawlins
# SPDX-License-Identifier: Apache-2.0

# The khold block service (services/khold/, .kiro/specs/khold-block-service/).
# Sourced from the top-level Kconfig's "Service Modules" menu.

config KHOLD
	bool "khold: Raft-replicated network block volumes for antikythera"
	default n
	help
	  Builds the services/khold/ module: a block service that stores
	  antikythera network volumes in Raft stripe groups and speaks hold
	  wire version 2 to antikythera's oar-blk initiator, running beside
	  antikythera's hold per volume class until it reaches feature and
	  testing parity. So far the module holds the khold_node placeholder
	  and the check that antikythera's wire formats, consumed through the
	  antikythera-proto overlay port, reproduce antikythera's test
	  vectors (task 1); the Raft append sink, witness voters and commit
	  predicates land in core, and the block store, stripe groups,
	  gateway and controller follow. Needs a C++ library with
	  std::expected (GCC 13+ or Clang 19+ over libstdc++); on Clang 18 the
	  build skips it. Off by default like every new module
	  (services/README.md). See .kiro/specs/khold-block-service/.
```

## services/kms/Kconfig
```kconfig
# Copyright (c) 2026 Clark Rawlins
# SPDX-License-Identifier: Apache-2.0

# The KMS-compatible service (services/kms/, .kiro/specs/kms-compatible-api/).
# Sourced from the top-level Kconfig's "Service Modules" menu.

config KMS
	bool "KMS-compatible key management service"
	default n
	depends on HSM && IAM
	help
	  Builds the services/kms/ module: AWS KMS's JSON 1.1 API, so the AWS
	  CLI, the SDKs and the AWS Encryption SDK work against it unchanged,
	  with every key's material a non-extractable object on the virtual
	  HSM and every request authorized by IAM with the key's policy. So
	  far the module holds the pinned botocore model, its generated shape
	  tables, the coverage check and the kms_node placeholder (task 1);
	  the catalog, the HSM binding and the API follow. Needs the HSM and
	  IAM modules. Off by default like every new module
	  (services/README.md). See .kiro/specs/kms-compatible-api/.
```

## services/s3/Kconfig
```kconfig
# Copyright (c) 2026 Clark Rawlins
# SPDX-License-Identifier: Apache-2.0

# The Amazon S3-compatible object storage service (services/s3/,
# .kiro/specs/s3-compatible-storage/). Sourced from the top-level Kconfig's
# "Service Modules" menu.

config S3
	bool "Amazon S3-compatible object storage service"
	default n
	depends on OPENSSL
	help
	  Builds the services/s3/ module: an Amazon S3-compatible object
	  store that unmodified AWS SDKs, the AWS CLI, rclone and Mountpoint
	  for Amazon S3 can point at, with object metadata in Kythira's Raft
	  groups and object bytes in content-addressed chunks outside the
	  Raft log. Service module number 8. s3_gateway_node runs any of
	  the four layers (gateway, front_end, metadata, blobs) a node is
	  given in KYTHIRA_S3_ROLES, co-located by default; --help lists
	  its settings. OpenSSL is needed for
	  SigV4, chunk digests and server-side encryption. Off by default
	  like every new module (services/README.md). See
	  .kiro/specs/s3-compatible-storage/.
```

## services/sns/Kconfig
```kconfig
# Copyright (c) 2026 Clark Rawlins
# SPDX-License-Identifier: Apache-2.0

# The Amazon SNS-compatible publish/subscribe service (services/sns/,
# .kiro/specs/sns-compatible-notifications/). Sourced from the top-level
# Kconfig's "Service Modules" menu.

config SNS
	bool "Amazon SNS-compatible publish/subscribe service"
	default n
	depends on OPENSSL
	help
	  Builds the services/sns/ module: an Amazon SNS-compatible
	  publish/subscribe service that unmodified AWS SDKs and the AWS CLI
	  can point at to create topics, subscribe SQS queues, HTTP/HTTPS
	  endpoints and email addresses, and publish. Each topic's messages
	  commit through Kythira's Raft groups into a publish log in the
	  record segment store, which delivery workers read. So far the
	  module holds the pinned botocore model, the generated operation
	  table, the coverage check and the sns_node placeholder (task 1);
	  the gateway, front end, topic state machine and delivery follow.
	  It needs IAM's core SigV4 and authorizer headers, not the IAM
	  module. OpenSSL is needed for SigV4 and message signatures. Off by
	  default like every new module (services/README.md). See
	  .kiro/specs/sns-compatible-notifications/.
```

## services/sqs/Kconfig
```kconfig
# Copyright (c) 2026 Clark Rawlins
# SPDX-License-Identifier: Apache-2.0

# The Amazon SQS-compatible message queue service (services/sqs/,
# .kiro/specs/sqs-compatible-queues/). Sourced from the top-level Kconfig's
# "Service Modules" menu.

config SQS
	bool "Amazon SQS-compatible message queue service"
	default n
	depends on OPENSSL
	help
	  Builds the services/sqs/ module: an Amazon SQS-compatible queue
	  service that unmodified AWS SDKs, the AWS CLI, JMS, Spring Cloud
	  AWS, Celery and Kombu can point at, with each queue's messages,
	  visibility and FIFO state kept in Kythira's Raft groups on the
	  persistent key-value engine. So far the module holds the pinned
	  botocore model, the generated operation table, the coverage check
	  and the sqs_node placeholder (task 1); the gateway, front end and
	  queue state machine follow. It needs IAM's core SigV4 and authorizer
	  headers, not the IAM module. OpenSSL is needed for SigV4, MD5
	  digests and receipt-handle HMACs. Off by default like every new
	  module (services/README.md). See .kiro/specs/sqs-compatible-queues/.
```
